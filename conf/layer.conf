## conf/layer.conf
```bitbake
# We have a conf and classes directory, add to BBPATH
BBPATH .= ":${LAYERDIR}"

# We have recipes-* directories, add to BBFILES
BBFILES += "${LAYERDIR}/recipes-*/*/*.bb \
            ${LAYERDIR}/recipes-*/*/*.bbappend"

BBFILE_COLLECTIONS += "meta-mcp9808"
BBFILE_PATTERN_meta-mcp9808 = "^${LAYERDIR}/"
BBFILE_PRIORITY_meta-mcp9808 = "6"

LAYERDEPENDS_meta-mcp9808 = "core"
LAYERSERIES_COMPAT_meta-mcp9808 = "kirkstone"
```
